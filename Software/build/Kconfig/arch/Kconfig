## Software/build/Kconfig/arch/Kconfig
```kconfig
# Load Zephyr Arch Kconfig descriptions.
osource "/home/crc/zephyrproject/zephyr/arch/x86/Kconfig"
osource "/home/crc/zephyrproject/zephyr/arch/xtensa/Kconfig"
osource "/home/crc/zephyrproject/zephyr/arch/sparc/Kconfig"
osource "/home/crc/zephyrproject/zephyr/arch/riscv/Kconfig"
osource "/home/crc/zephyrproject/zephyr/arch/posix/Kconfig"
osource "/home/crc/zephyrproject/zephyr/arch/nios2/Kconfig"
osource "/home/crc/zephyrproject/zephyr/arch/mips/Kconfig"
osource "/home/crc/zephyrproject/zephyr/arch/arm64/Kconfig"
osource "/home/crc/zephyrproject/zephyr/arch/arm/Kconfig"
osource "/home/crc/zephyrproject/zephyr/arch/arc/Kconfig"
```

## Software/build/Kconfig/boards/Kconfig
```kconfig
# Load Zephyr board Kconfig descriptions.
osource "/home/crc/zephyrproject/zephyr/boards/espressif/esp32_devkitc_wroom/Kconfig"
```

## Software/build/Kconfig/boards/Kconfig.defconfig
```kconfig
# Load Zephyr board defconfig descriptions.
osource "/home/crc/zephyrproject/zephyr/boards/espressif/esp32_devkitc_wroom/Kconfig.defconfig"
```

## Software/build/Kconfig/boards/Kconfig.doit_esp32_devkit_v1
```kconfig
# Load board Kconfig descriptions.
osource "/home/crc/zephyrproject/zephyr/boards/others/doit_esp32_devkit_v1/Kconfig.doit_esp32_devkit_v1"
```

## Software/build/Kconfig/boards/Kconfig.sysbuild.tmp
```kconfig
# Load Sysbuild board Kconfig descriptions.
osource "/home/crc/zephyrproject/zephyr/boards/others/doit_esp32_devkit_v1/Kconfig.sysbuild"
```

## Software/build/Kconfig/boards/Kconfig.tmp
```kconfig
# Load Zephyr board Kconfig descriptions.
osource "/home/crc/zephyrproject/zephyr/boards/others/doit_esp32_devkit_v1/Kconfig"
```
